## boards/arm/zgm_001/Kconfig.zgm_001
```kconfig
# Copyright (c) 2019 Richard Osterloh <richard.osterloh@gmail.com>
# SPDX-License-Identifier: Apache-2.0

config BOARD_ZGM_001
	select SOC_STM32G431XX
    	select USE_STM32_LL_TIM
	select USE_STM32_LL_RCC
    	select USE_STM32_LL_ADC    
```
